## boards/sdkconfig.defaults.dfrobot_firebeetle_esp32e
```kconfig
# DFRobot FireBeetle 2 ESP32-E with Waveshare 4inch e-Paper HAT+ E
CONFIG_BOARD_DRIVER_DFROBOT_FIREBEETLE_ESP32E=y

# Target chip: classic ESP32 (not S3)
# NOTE: Before first build, run: idf.py set-target esp32
CONFIG_IDF_TARGET="esp32"

# Flash: FireBeetle ESP32-E (WROOM-32E) has 4MB flash
CONFIG_ESPTOOLPY_FLASHSIZE_4MB=y
CONFIG_ESPTOOLPY_FLASHSIZE="4MB"

# No PSRAM on standard WROOM-32E module
# The 120KB image buffer (600x400/2) fits in internal SRAM
CONFIG_SPIRAM=n

# No internal flash storage partition (4MB flash is tight with app + OTA)
# Image processing uses RAM-based MemFS instead
CONFIG_USE_INTERNAL_FLASH_STORAGE=n

# Custom partition table: single factory partition (no OTA - binary too large for two OTA slots on 4MB)
CONFIG_PARTITION_TABLE_CUSTOM=y
CONFIG_PARTITION_TABLE_CUSTOM_FILENAME="boards/partitions.dfrobot_firebeetle_esp32e.csv"

# Disable OTA (no OTA slots in partition table)
CONFIG_APP_UPDATE_PARTITION_PREFER_NVS_FACTORY=n

# HTTPS support: compile in the FULL Mozilla CA bundle so the device can verify
# public certificates (Let's Encrypt etc.) served by a reverse proxy, without
# manual cert pinning. utils.c falls back to esp_crt_bundle_attach when no cert
# is pinned. A clean build otherwise defaults to the smaller CMN list, which can
# miss some roots; pin FULL here for reproducible HTTPS on fresh builds.
# Verified on hardware 2026-06-07: valid cert -> fetch ok; expired cert -> rejected.
CONFIG_MBEDTLS_CERTIFICATE_BUNDLE=y
CONFIG_MBEDTLS_CERTIFICATE_BUNDLE_DEFAULT_FULL=y

# Memory optimization for HTTPS on SRAM-only boards
# Dynamic TLS buffers: only allocate during active TLS connections instead of statically
# This frees ~20KB SRAM when no TLS connection is in use
CONFIG_MBEDTLS_DYNAMIC_BUFFER=y
# Reduce TLS output buffer (JPEG images come in chunks, 4KB output is enough)
CONFIG_MBEDTLS_SSL_OUT_CONTENT_LEN=4096
# Reduce TLS input buffer - 8KB saves 8KB vs default 16KB while still handling most TLS records
CONFIG_MBEDTLS_SSL_IN_CONTENT_LEN=8192
```

## boards/sdkconfig.defaults.dfrobot_firebeetle_esp32s3
```kconfig
# DFRobot FireBeetle 2 ESP32-S3 Specifics
CONFIG_BOARD_DRIVER_DFROBOT_FIREBEETLE_ESP32S3=y

# Internal flash storage (LittleFS) — 16MB flash has plenty of room
CONFIG_USE_INTERNAL_FLASH_STORAGE=y

# Console stays on the default UART0 (NOT USB-Serial-JTAG). Routing the console
# to USB-SJ froze the frame on the XIAO EE04 (same native-USB situation as this
# board): the console TX blocks when a USB host holds the port open without
# draining it, stalling the render loop until the task watchdog resets the
# board. Improv still provisions over USB-SJ, gated on the chip target in
# improv_serial.c, independent of the console.
#
# Confirmed 2026-07-03: this board's USB-CDC (COM14) never carries console
# output regardless of this setting (tooling/peripheral limitation, not a
# firmware bug) — use a real UART-to-USB adapter on D43/TXD0 (GPIO43) +
# D44/RXD0 (GPIO44) + GND for console access during bring-up/debugging.
```

## boards/sdkconfig.defaults.seeedstudio_reterminal_e1002
```kconfig
# Seeed Studio reTerminal E1002 Specifics
CONFIG_BOARD_DRIVER_SEEEDSTUDIO_RETERMINAL_E1002=y

# Flash Configuration (32MB with 80MHz QIO)
CONFIG_ESPTOOLPY_FLASHSIZE_32MB=y
CONFIG_ESPTOOLPY_FLASHSIZE="32MB"
CONFIG_ESPTOOLPY_FLASHFREQ_80M=y

# Internal flash storage (LittleFS)
CONFIG_USE_INTERNAL_FLASH_STORAGE=y

# Console stays on the default UART0 (NOT USB-Serial-JTAG). Routing the console
# to USB-SJ froze the frame: the console TX blocks when a USB host holds the port
# open without draining it (frame USB-powered from a PC), stalling the render loop
# until the task watchdog resets the board — a rotate-then-reboot loop. Improv
# still provisions over USB-SJ, gated on the chip target in improv_serial.c,
# independent of the console.
```

## boards/sdkconfig.defaults.seeedstudio_xiao_ee02
```kconfig
# Seeed XIAO EE02 Specifics
CONFIG_BOARD_DRIVER_SEEEDSTUDIO_XIAO_EE02=y

# Flash Configuration
CONFIG_ESPTOOLPY_FLASHSIZE_16MB=y
CONFIG_ESPTOOLPY_FLASHSIZE="16MB"

# Internal flash storage (LittleFS)
CONFIG_USE_INTERNAL_FLASH_STORAGE=y

# Console stays on the default UART0 (NOT USB-Serial-JTAG). Routing the console
# to USB-SJ froze the frame: the console TX blocks when a USB host holds the port
# open without draining it (frame USB-powered from a PC), stalling the render loop
# until the task watchdog resets the board — a rotate-then-reboot loop. Improv
# still provisions over USB-SJ, gated on the chip target in improv_serial.c,
# independent of the console.
```

## boards/sdkconfig.defaults.waveshare_photopainter_73
```kconfig
# WaveShare 7.3 Inch Specifics
CONFIG_BOARD_DRIVER_WAVESHARE_PHOTOPAINTER_73=y

# Flash Configuration
CONFIG_ESPTOOLPY_FLASHSIZE_16MB=y
CONFIG_ESPTOOLPY_FLASHSIZE="16MB"

# Console stays on the default UART0 (NOT USB-Serial-JTAG). Routing the console
# to USB-SJ froze the frame: the console TX blocks when a USB host holds the port
# open without draining it (frame USB-powered from a PC), stalling the render loop
# until the task watchdog resets the board — a rotate-then-reboot loop. Improv
# still provisions over USB-SJ, gated on the chip target in improv_serial.c,
# independent of the console.
```

## components/epaper_driver_ws4in_e6/Kconfig
```kconfig
config EP_DRIVER_WS4IN_E6
    bool "Waveshare 4inch E-Paper HAT+ E (Spectra 6, 600x400)"
    help
        Driver for Waveshare 4inch e-Paper HAT+ E (E6/Spectra 6, 600x400 pixels).
        Uses the same Spectra 6 protocol as the 7.3-inch ED2208-GCA display,
        with resolution adjusted to 600x400.
```
